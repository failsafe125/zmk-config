## config/boards/shields/antari/boards/seeeduino_xiao_ble.conf
```kconfig
# nRF52840 (BLE) board only: enable soft off (deep power-down)
# Triggered by holding the encoder press for 5 seconds.
CONFIG_ZMK_PM_SOFT_OFF=y
```
